## src/Kconfig.projbuild
```kconfig
menu "StickS3 application transport"

choice APP_TRANSPORT
    prompt "Application transport"
    default APP_TRANSPORT_BLE_GATT_RULE_EVENTS
    help
        Select the application transport used by the configuration and
        automation firmware.

config APP_TRANSPORT_NONE
    bool "No wireless event transport selected"
    help
        Board bring-up only. The firmware initializes local UI, Wi-Fi, and
        automation support without a BLE rule-event service.

config APP_TRANSPORT_BLE_GATT_RULE_EVENTS
    bool "Bluetooth LE GATT rule-event transport"
    select BT_ENABLED
    help
        Start a custom Bluetooth Low Energy GATT service for status reads and
        local automation rule-event notifications. This transport does not
        expose microphone, PCM, sound-level, or display-mode
        characteristics.

endchoice

if APP_TRANSPORT_BLE_GATT_RULE_EVENTS

config APP_BLE_GATT_DEVICE_NAME
    string "BLE GATT device name"
    default "M5StickS3-Control"

endif

endmenu


menu "StickS3 Wi-Fi and web UI"

config APP_WIFI_ENABLE
    bool "Enable Wi-Fi station/setup AP for web UI"
    default y
    help
        Start ESP-IDF Wi-Fi during boot, try saved station credentials, and
        fall back to a setup access point. The local HTTP Web UI server is
        started only when the on-device Web UI flow enables it, so disabling
        Web UI can stop the server and release its RAM resources.

config APP_WIFI_AP_SSID
    string "Setup access point SSID"
    default "M5StickS3-Setup"
    depends on APP_WIFI_ENABLE

config APP_WIFI_AP_PASSWORD
    string "Setup access point password (8+ characters to enable AP)"
    default ""
    depends on APP_WIFI_ENABLE
    help
        Blank disables AP startup until a password is set through the LCD.
        ESP Wi-Fi requires at least eight characters for WPA2-PSK.

config APP_WIFI_AP_CHANNEL
    int "Setup access point channel"
    default 6
    range 1 13
    depends on APP_WIFI_ENABLE

config APP_WIFI_AP_MAX_CONNECTIONS
    int "Setup access point max clients"
    default 4
    range 1 8
    depends on APP_WIFI_ENABLE

config APP_WIFI_CONNECT_TIMEOUT_MS
    int "Station connection timeout in milliseconds"
    default 15000
    range 1000 60000
    depends on APP_WIFI_ENABLE

config APP_WIFI_NTP_SYNC_TIMEOUT_MS
    int "SNTP time synchronization timeout in milliseconds"
    default 15000
    range 1000 60000
    depends on APP_WIFI_ENABLE

config APP_WIFI_MAX_SCAN_RESULTS
    int "Maximum Wi-Fi scan results shown in web UI"
    default 12
    range 1 32
    depends on APP_WIFI_ENABLE

config APP_WIFI_KEYBOARD_PROVISIONING
    bool "Prompt for Wi-Fi credentials on the LCD keyboard at boot"
    default n
    depends on APP_WIFI_ENABLE && APP_STATUS_UI_LCD
    help
        When saved station credentials are missing or fail, show a Launcher-style
        virtual keyboard on the StickS3 LCD before falling back to the setup AP.
        This is disabled by default so boot continues to the normal dashboard and
        credentials can be entered from Connect to Wi-Fi or from the Web UI after it is enabled.

config APP_WIFI_KEYBOARD_TIMEOUT_MS
    int "LCD keyboard provisioning timeout in milliseconds"
    default 0
    range 0 300000
    depends on APP_WIFI_KEYBOARD_PROVISIONING
    help
        Timeout for each SSID/password keyboard prompt. Set to 0 to wait
        indefinitely.

endmenu

menu "StickS3 time settings"

config APP_TIMEZONE
    string "Default POSIX timezone"
    default "UTC"
    help
        Default timezone applied to the status bar clock before any web UI
        override is saved. Use UTC for Coordinated Universal Time or a POSIX
        TZ string such as EST5EDT,M3.2.0/2,M11.1.0/2. The clock always renders
        in 24-hour HH:MM format.

endmenu

menu "StickS3 status UI"

config APP_STATUS_UI_LCD
    bool "Render debug status on the onboard ST7789P3 LCD"
    default y
    help
        Initialize the StickS3 onboard 135x240 ST7789P3 LCD and render a
        local configuration launcher. If LCD initialization
        fails, button polling and transport startup continue.

config APP_STATUS_UI_LCD_REFRESH_MS
    int "LCD refresh period in ms"
    default 100
    range 50 2000
    depends on APP_STATUS_UI_LCD

endmenu



menu "StickS3 USB Audio Class"

config APP_USB_UAC_DEVICE
    bool "Enable experimental USB Audio Class device profile"
    default n
    help
        Enable the opt-in StickS3 USB Audio Class firmware path. This is not
        part of the default local automation image and uses the ESP32-S3 native
        USB device PHY on the USB-C connector. Runtime logging should not rely
        on USB-Serial-JTAG while UAC owns the internal PHY.

config APP_USB_UAC_MIC
    bool "Enable USB Audio Class microphone direction"
    default n
    depends on APP_USB_UAC_DEVICE
    help
        Enable the microphone direction. The implementation uses the StickS3
        ES8311 ADC and I2S capture path.

config APP_USB_UAC_SPEAKER
    bool "Enable USB Audio Class speaker direction"
    default n
    depends on APP_USB_UAC_DEVICE
    help
        Enable the speaker direction. The implementation uses the StickS3
        ES8311 DAC, I2S playback path, and battery-safe volume clamping.

config APP_USB_UAC_COMBINED_EXPERIMENTAL
    bool "Allow combined UAC input/output descriptors"
    default n
    depends on APP_USB_UAC_MIC && APP_USB_UAC_SPEAKER
    help
        Allows both UAC directions to be described in one firmware image. This
        is not by itself evidence of validated simultaneous mic+speaker audio.

config APP_USB_UAC_SIMULTANEOUS_MIC_SPEAKER
    bool "Enable experimental simultaneous mic+speaker streaming"
    default n
    depends on APP_USB_UAC_COMBINED_EXPERIMENTAL
    help
        Enables the explicit simultaneous mic+speaker owner profile. Keep this
        disabled unless real StickS3 hardware validation has been performed.

config APP_USB_UAC_SAMPLE_RATE_HZ
    int "USB Audio Class sample rate"
    default 16000
    range 16000 16000
    depends on APP_USB_UAC_DEVICE
    help
        Current source-backed UAC sample rate. Keep fixed at 16 kHz until a
        future phase adds tested ES8311 and I2S clock profiles for additional
        rates.

config APP_USB_UAC_RING_BUFFER_BYTES
    int "USB Audio Class ring buffer bytes"
    default 16384
    range 4096 131072
    depends on APP_USB_UAC_DEVICE

endmenu

menu "StickS3 speaker actions"

config APP_SPEAKER_ACTION
    bool "Enable speaker tone automation action"
    depends on !APP_USB_UAC_DEVICE
    default y
    help
        Allow automation rules to play a short tone through the StickS3 ES8311
        speaker path. The implementation follows the official single-owner
        microphone/speaker model, caps requested volume below 75% for battery
        safety, and enables the M5PM1-controlled speaker amplifier only while
        the action is playing.

endmenu

menu "StickS3 sound-level triggers"

config APP_SOUND_LEVEL_TRIGGERS
    bool "Enable sound-level trigger capture"
    depends on !APP_USB_UAC_DEVICE
    default y

config APP_SOUND_LEVEL_SAMPLE_RATE_HZ
    int "Sound trigger sample rate"
    default 16000
    depends on APP_SOUND_LEVEL_TRIGGERS

config APP_SOUND_LEVEL_WINDOW_MS
    int "Sound trigger metrics window"
    default 100
    range 20 1000
    depends on APP_SOUND_LEVEL_TRIGGERS

config APP_SOUND_LEVEL_READ_TIMEOUT_MS
    int "Sound trigger I2S read timeout"
    default 20
    range 1 1000
    depends on APP_SOUND_LEVEL_TRIGGERS

config APP_SOUND_LEVEL_CALIBRATE_ON_START
    bool "Calibrate sound floor on startup"
    default y
    depends on APP_SOUND_LEVEL_TRIGGERS

config APP_SOUND_LEVEL_CALIBRATION_WINDOWS
    int "Sound calibration windows"
    default 30
    range 1 600
    depends on APP_SOUND_LEVEL_TRIGGERS

config APP_SOUND_LEVEL_FAIL_BOOT_ON_AUDIO_ERROR
    bool "Fail boot if sound-trigger audio init fails"
    default n
    depends on APP_SOUND_LEVEL_TRIGGERS

endmenu

menu "StickS3 hardware automation facts"

config APP_BATTERY_FACTS
    bool "Enable battery-percent automation facts"
    default y
    help
        Compile M5PM1-backed power.battery_percent facts into the firmware.
        The project sdkconfig defaults keep this enabled for the standard
        StickS3 build; disable only for an explicit hardware-fact opt-out build.

config APP_USB_POWER_FACTS
    bool "Enable USB/external-power automation facts"
    default y
    help
        Compile M5PM1-backed power.usb_present facts into the firmware.
        The project sdkconfig defaults keep this enabled for the standard
        StickS3 build; disable only for an explicit hardware-fact opt-out build.

config APP_BMI270_FACTS
    bool "Enable BMI270 motion automation facts"
    default y
    help
        Compile polling-only bmi270.motion facts into the firmware. The
        project sdkconfig defaults keep this enabled for the standard StickS3
        build; disable only for an explicit hardware-fact opt-out build.

config APP_ADC_FACTS
    bool "Enable safe ADC voltage automation facts"
    default y
    help
        Compile adc.voltage_mv facts for the safe ADC1 Grove/Hat allowlist
        into the firmware. The project sdkconfig defaults keep this enabled
        for the standard StickS3 build; disable only for an explicit
        hardware-fact opt-out build.

config APP_HARDWARE_FACT_POLL_INTERVAL_MS
    int "Hardware fact polling interval in milliseconds"
    default 1000
    range 100 60000

config APP_BMI270_MOTION_DELTA_MG
    int "BMI270 motion delta threshold in mg"
    default 120
    range 10 2000

config APP_POWER_USB_PRESENT_MV
    int "USB/VIN present threshold in millivolts"
    default 4400
    range 3000 5500

endmenu
```
